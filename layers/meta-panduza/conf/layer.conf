## layers/meta-panduza/conf/layer.conf
```bitbake
# We have a conf and classes directory, add to BBPATH
BBPATH .= ":${LAYERDIR}"

# We have recipes-* directories, add to BBFILES
BBFILES += "${LAYERDIR}/recipes-*/*/*.bb \
            ${LAYERDIR}/recipes-*/*/*.bbappend"

BBFILE_COLLECTIONS += "meta-panduza"
BBFILE_PATTERN_meta-panduza = "^${LAYERDIR}/"
BBFILE_PRIORITY_meta-panduza = "6"

LAYERDEPENDS_meta-panduza = "core"
LAYERSERIES_COMPAT_meta-panduza = "kirkstone"
```
